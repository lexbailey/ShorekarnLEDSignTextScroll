int pinData = 2;
int pinClock = 3;
int pinEnable = 4;
int pinRow1 = 5;
int pinRow2 = 6;
int pinRow4 = 7;

#define ROWS 7
#define COLS 40

#define PULSETIME 1000

#define TIMESTEP 20

#define NUMCHARS 127

//Number of cols per character
#define CCOLS 8

// Maximum number of characters allowed in the buffer, multiplied by CCOLS
// In this example, 170 characters (140 chars plus 15 spaces at each end for providing a delay)
#define SHIFTLIMIT ((140*8) + (30*8))

int frame[ROWS][COLS+CCOLS];

int font[NUMCHARS][ROWS] = {
  {0x0, 0x0, 0x0, 0x0, 0x0, 0x0, 0x0},
  {0x0, 0x0, 0x0, 0x0, 0x0, 0x0, 0x0},  
  {0x0, 0x0, 0x0, 0x0, 0x0, 0x0, 0x0},
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  {0x0, 0x0, 0xcc, 0x7e, 0x33, 0x0, 0x0},      //~
}; 
  
void setup() {
  //initialise the pins. All output
  pinMode(pinData, OUTPUT);
  pinMode(pinClock, OUTPUT);
  pinMode(pinEnable, OUTPUT);
  pinMode(pinRow1, OUTPUT);
  pinMode(pinRow2, OUTPUT);
  pinMode(pinRow4, OUTPUT);
}

void selectRow(int row){
  //Select the given row
  digitalWrite(pinRow1, row & 1);
  digitalWrite(pinRow2, row & 2);
  digitalWrite(pinRow4, row & 4);
}

void pulseRow(int pulseTimeUS){
  
  digitalWrite(pinEnable, LOW);
  delayMicroseconds(pulseTimeUS);
  digitalWrite(pinEnable, HIGH);  
  
}

void rowOut(int *rowData){
  int i;
  //Loop over all columns
  for (i = 0; i<= COLS-1; i++){
    //Set data pin high
    digitalWrite(pinData, *rowData++);
    //Pulse clock
    delayMicroseconds(2);    
    digitalWrite(pinClock, HIGH);
    delayMicroseconds(2);
    digitalWrite(pinClock, LOW);    
  }
}

void rowOutShift(int *rowData, int shift){

  int loopLimit, loopStart;
  
  if (shift<=0){
    int s;
    //Set data pinlow to shift out extra data
    digitalWrite(pinData, LOW);    
    for (s = 0; s<= -shift-1; s++){
      //Pulse clock
      delayMicroseconds(2);    
      digitalWrite(pinClock, HIGH);
      delayMicroseconds(2);
      digitalWrite(pinClock, LOW);    
    } 
    loopLimit = COLS-1+shift;
    loopStart = 0;
  }
  else{
    loopLimit = COLS-1;
    loopStart = shift;
  }
  int i;
  //Loop over all columns

  rowData+=loopStart;

  for (i = loopStart; i<= loopLimit; i++){
    //Set data pin
    digitalWrite(pinData, *rowData++);
    //Pulse clock
    delayMicroseconds(2);    
    digitalWrite(pinClock, HIGH);
    delayMicroseconds(2);
    digitalWrite(pinClock, LOW);    
  }
  
  if (shift > 0){
    digitalWrite(pinData, LOW);   
     int s; 
    for (s = 0; s<= shift-1; s++){
      digitalWrite(pinData, *rowData++);      
      //Pulse clock

      delayMicroseconds(2);    
      digitalWrite(pinClock, HIGH);
      delayMicroseconds(2);
      digitalWrite(pinClock, LOW);    
    } 
  }
}

unsigned long lastTime = 0;

char *text = "         This is a test message that I would like to scroll across the screen. To change text at run time, set text to point to a different string.         ";

void generateFrame(int scroll){
  char *textPos = text;
  textPos += scroll / (CCOLS+1);
  scroll = scroll % (CCOLS+1);
  int row, col;
  for (row = 0; row<= ROWS-1; row++){  
    for (col = 0; col<= COLS+CCOLS-1; col++){
      frame[row][col] = font[textPos[col/(CCOLS+1)]][row]&(1<<(col%(CCOLS+1)));
    }
  }
}

int shift = 0;

void textLoop(){
  if (millis()-TIMESTEP > lastTime){
    //shift
    shift++;
    if (shift > SHIFTLIMIT){
      shift = 0;
    }
    generateFrame(shift);
    lastTime = millis();
  }
  
  int row;
  for(row = 0; row <= ROWS-1; row++){
    selectRow(ROWS-1-row);
    rowOutShift(frame[row], shift%(CCOLS+1));
    pulseRow(PULSETIME);
  }
}



void loop() {
  textLoop();
}
